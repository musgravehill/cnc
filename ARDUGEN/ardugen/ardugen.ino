/* Генератор с регулируемой частотой и скважностью на Ардуино Уно v 2.3
   Распиновка: Энкодер A0,A1 (in)
   Кнопка энкодера A3 (in)
   Кнопка "режим" A2 (in)
    Выход генератора 0..7 + 9 (out)
    A4 A5 i2c monitor

    up_down(boolean x) { // управление регулировками
  static boolean n=0;  if (n=!n){return;} //фикс  двойного щелчка энкодера 
*/

#include <Wire.h>
#include <LiquidCrystal_I2C.h>

LiquidCrystal_I2C lcd(0x3F, 16, 2);


const PROGMEM uint8_t  sinewave[] = // массив синуса
{
  0x80, 0x83, 0x86, 0x89, 0x8c, 0x8f, 0x92, 0x95, 0x98, 0x9c, 0x9f, 0xa2, 0xa5, 0xa8, 0xab, 0xae,
  0xb0, 0xb3, 0xb6, 0xb9, 0xbc, 0xbf, 0xc1, 0xc4, 0xc7, 0xc9, 0xcc, 0xce, 0xd1, 0xd3, 0xd5, 0xd8,
  0xda, 0xdc, 0xde, 0xe0, 0xe2, 0xe4, 0xe6, 0xe8, 0xea, 0xec, 0xed, 0xef, 0xf0, 0xf2, 0xf3, 0xf5,
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  0x4f, 0x51, 0x54, 0x57, 0x5a, 0x5d, 0x60, 0x63, 0x67, 0x6a, 0x6d, 0x70, 0x73, 0x76, 0x79, 0x7c
};

const PROGMEM uint8_t squarewave[] = //массив меандра
{
  0x00, 0x00, 0x00, 0x00, 0x00, 0x00, 0x00, 0x00, 0x00, 0x00, 0x00, 0x00, 0x00, 0x00, 0x00, 0x00,
  0x00, 0x00, 0x00, 0x00, 0x00, 0x00, 0x00, 0x00, 0x00, 0x00, 0x00, 0x00, 0x00, 0x00, 0x00, 0x00,
  0x00, 0x00, 0x00, 0x00, 0x00, 0x00, 0x00, 0x00, 0x00, 0x00, 0x00, 0x00, 0x00, 0x00, 0x00, 0x00,
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  0xff, 0xff, 0xff, 0xff, 0xff, 0xff, 0xff, 0xff, 0xff, 0xff, 0xff, 0xff, 0xff, 0xff, 0xff, 0xff,
};

const PROGMEM uint8_t trianglewave[] = //массив треугольника
{
  0x00, 0x02, 0x04, 0x06, 0x08, 0x0a, 0x0c, 0x0e, 0x10, 0x12, 0x14, 0x16, 0x18, 0x1a, 0x1c, 0x1e,
  0x20, 0x22, 0x24, 0x26, 0x28, 0x2a, 0x2c, 0x2e, 0x30, 0x32, 0x34, 0x36, 0x38, 0x3a, 0x3c, 0x3e,
  0x40, 0x42, 0x44, 0x46, 0x48, 0x4a, 0x4c, 0x4e, 0x50, 0x52, 0x54, 0x56, 0x58, 0x5a, 0x5c, 0x5e,
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  0x1f, 0x1d, 0x1b, 0x19, 0x17, 0x15, 0x13, 0x11, 0x0f, 0x0f, 0x0b, 0x09, 0x07, 0x05, 0x03, 0x01
};

const PROGMEM uint8_t sawtoothwave[] = //массив пила1
{
  0x00, 0x01, 0x02, 0x03, 0x04, 0x05, 0x06, 0x07, 0x08, 0x09, 0x0a, 0x0b, 0x0c, 0x0d, 0x0e, 0x0f,
  0x10, 0x11, 0x12, 0x13, 0x14, 0x15, 0x16, 0x17, 0x18, 0x19, 0x1a, 0x1b, 0x1c, 0x1d, 0x1e, 0x1f,
  0x20, 0x21, 0x22, 0x23, 0x24, 0x25, 0x26, 0x27, 0x28, 0x29, 0x2a, 0x2b, 0x2c, 0x2d, 0x2e, 0x2f,
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  0xf0, 0xf1, 0xf2, 0xf3, 0xf4, 0xf5, 0xf6, 0xf7, 0xf8, 0xf9, 0xfa, 0xfb, 0xfc, 0xfd, 0xfe, 0xff
};

const PROGMEM uint8_t rewsawtoothwave[] = //массив пила2
{
  0xff, 0xfe, 0xfd, 0xfc, 0xfb, 0xfa, 0xf9, 0xf8, 0xf7, 0xf6, 0xf5, 0xf4, 0xf3, 0xf2, 0xf1, 0xf0,
  0xef, 0xee, 0xed, 0xec, 0xeb, 0xea, 0xe9, 0xe8, 0xe7, 0xe6, 0xe5, 0xe4, 0xe3, 0xe2, 0xe1, 0xe0,
  0xdf, 0xde, 0xdd, 0xdc, 0xdb, 0xda, 0xd9, 0xd8, 0xd7, 0xd6, 0xd5, 0xd4, 0xd3, 0xd2, 0xd1, 0xd0,
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  0x0f, 0x0e, 0x0d, 0x0c, 0x0b, 0x0a, 0x09, 0x08, 0x07, 0x06, 0x05, 0x04, 0x03, 0x02, 0x01, 0x00,
};


const PROGMEM char musor_mass[] = //массив для подгонки адреса в флэш-памяти
{
  0x00, 0x00, 0x00, 0x00, 0x00, 0x00, 0x00, 0x00, 0x00, 0x00,
  0x00, 0x00, 0x00, 0x00, 0x00, 0x00, 0x00, 0x00, 0x00, 0x00, 0x00, 0x00, 0x00, 0x00, 0x00, 0x00,
  0x00, 0x00, 0x00, 0x00, 0x00, 0x00, 0x00, 0x00, 0x00, 0x00, 0x00, 0x00, 0x00, 0x00, 0x00, 0x00,
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  0x00, 0x00, 0x00, 0x00, 0x00, 0x00, 0x00, 0x00, 0x00, 0x00, 0x00, 0x00, 0x00, 0x00, 0x00, 0x00,
};


volatile int32_t freq = 1000; // частота по умолчанию
volatile uint16_t shag = 100; //шаг энкодера по умолчанию
volatile uint8_t regim = 5; //режим генератора по умолчанию
volatile uint8_t monitor_flag; // флаг для вывода на дисплей
volatile uint8_t ad2, ad1, ad0; //служебные байты для функции на ассемблере
volatile uint8_t duty = 50; //скважность
volatile uint32_t icr = 0; //переменная для управления регистром сравнения таймера1



// DDS algorithm
static inline void signalOUT(const uint8_t *signal) {
  asm volatile(  "eor r18, r18   ;r18<-0"  "\n\t"
                 "eor r19, r19   ;r19<-0"  "\n\t"
                 "1:"            "\n\t"
                 "add r18, %0  ;1 cycle"     "\n\t"
                 "adc r19, %1  ;1 cycle"     "\n\t"
                 "adc %A3, %2  ;1 cycle"     "\n\t"
                 "lpm      ;3 cycles"  "\n\t"
                 "out %4, __tmp_reg__  ;1 cycle" "\n\t"
                 "sbis %5, 7   ;1 cycle if no skip" "\n\t"
                 "rjmp 1b    ;2 cycles. Total 10 cycles" "\n\t"
                 :
                 :"r" (ad0), "r" (ad1), "r" (ad2), "e" (signal), "I" (_SFR_IO_ADDR(PORTD)), "I" (_SFR_IO_ADDR(PORTB))
                 :"r18", "r19" );
}

void setup() {
  lcd.init();
  lcd.backlight();
  lcd.setCursor(0, 0);
  lcd.print("SINE ");
  lcd.print(100);

  for (int n = 0; n < sizeof(musor_mass); n++ ) {
    PORTD = musor_mass[n];
  }
  PORTC |= (1 << PC2) | (1 << PC3); //подтяжка кнопок на A2 A3
  TCCR0B = 0; TCCR1A = 0; TCCR1B = 0;
  PCICR = (1 << PCIE1); //включить прерывание PCINT
  PCMSK1 = (1 << PCINT9) | (1 << PCINT10) | (1 << PCINT11); //выбор пинов прерывания (A1,A2,A3)
  check_regim();
}


void up_down(boolean x) { // управление регулировками
  static boolean n=0;  if (n=!n){return;} //фикс  двойного щелчка энкодера

  if (TCCR1B == 17 && ICR1 < 2800 && regim == 5) {
    if (x) {
      if (icr < 1000 && shag > 100) shag = 100;
      if (icr < 100 && shag > 10) shag = 10;
      if (icr < 10 && shag > 1) shag = 1;
      icr -= shag;
      if (icr < 2) icr = 2;
    }
    else {
      if (icr > 1800 && shag > 100) shag = 100;
      icr += shag ;
    }
    return;
  }
  if (regim == 6) {

    if (ICR1 > 100) {

      if (x) {
        if (duty < 100) {
          duty++;
        }
      }

      if (!x) {
        if (duty > 0) {
          duty--;
        }
      }
    }
    else {
      if (x) {
        if (OCR1A < ICR1) {
          OCR1A++;
        }
      }
      else {
        if (OCR1A > 0) {
          OCR1A--;
        }
      }
      if (OCR1A > ICR1) OCR1A = ICR1 - 1;
      duty = (uint32_t)100 * OCR1A / ICR1;
    }
    return;
  }

  x ? freq += shag : freq -= shag ;
  if (freq < 1) freq = 1;
}



// ПРЕРЫВАНИЕ от кнопок и энкодера
ISR (PCINT1_vect) {
  PCMSK1 = 0; PCICR = 0;
  PORTD = 0;
  // если нажата кнопка энкодера
  if ((PINC & (1 << 3)) == 0) {
    while ((PINC & (1 << 3)) == 0); // подождать до тех пор, когда кнопку отпустят

    //блок вкл/отк подсветки дисплея (8 пин ардуино)
    if ((PINC & (1 << 2)) == 0) { //если после этого нажата кнопка режимов,
      PINB |= 1 << PB0; //менять состояние 8 пина
      while ((PINC & (1 << 2)) == 0); // теперь подождать пока отпустят кнопку режим
      PCMSK1 = (1 << PCINT9) | (1 << PCINT10) | (1 << PCINT11); PCICR = (1 << PCIE1); return;
    }
    if (regim == 6) {
      regim = 5;
      check_regim();
      PCMSK1 = (1 << PCINT9) | (1 << PCINT10) | (1 << PCINT11);
      PCICR = (1 << PCIE1);
      return;
    }
    switch (shag) {
      case 1: shag = 10;     break;
      case 10: shag = 100;    break;
      case 100: shag = 1000;   break;
      case 1000: shag = 1;
    }
    check_regim();
    PCMSK1 = (1 << PCINT9) | (1 << PCINT10) | (1 << PCINT11); PCICR = (1 << PCIE1); return;
  }
  if ((PINC & (1 << 2)) == 0) { // если нажата кнопка режимов
    PORTD = 0;
    while ((PINC & (1 << 2)) == 0);
    regim++; if (regim == 7) regim = 0;
    check_regim(); PCMSK1 = (1 << PCINT9) | (1 << PCINT10) | (1 << PCINT11); PCICR = (1 << PCIE1);  return;
  }

  // если кнопки не нажимались -значит крутили энкодер:
  up_down(  (PINC & 1) ^ ((PINC & 2) >> 1) ); //отправить считанное энкодеров в другую функцию
  // если при вращении счёт идёт не в нужную сторону, то вставить символ '!'   up_down(!
  check_regim();
  PCMSK1 = (1 << PCINT9) | (1 << PCINT10) | (1 << PCINT11); PCICR = (1 << PCIE1); //включить прерывания

} //конец функции обработки прерываний от кнопок PCINT1_vect


void pwm_gen() { //настройка таймера1
  uint16_t divider = 1;
  icr = (16000000ul / freq / 2 / divider);
  byte shifts[] = {3, 3, 2, 2};
  for (byte i = 0; i < 4; i++) {
    if (icr > 65536) {
      divider <<= shifts[i];
      icr = 16000000ul / freq / 2 / divider;
    }
    else {
      TCCR1B = (i + 1) | (1 << WGM13);  break;
    }
  }
  ICR1 = icr - 1;
  set_duty();
} //end pwm_gen


void loop() {
  if (monitor_flag) {
    monitor_flag = 0;
    monitor_out();
  }
  if (regim < 5) {
    PORTB &= ~(1 << 7);
    DDRD = 0xFF; //set D port as output
    uint32_t temp = (float)freq / 0.095367431640625;
    ad2 = temp >> 16; ad1 = temp >> 8; ad0 = temp;
    switch (regim) {
      case 0: signalOUT(sinewave); break;
      case 1: signalOUT(trianglewave); break;
      case 2: signalOUT(squarewave); break;
      case 3: signalOUT(sawtoothwave); break;
      case 4: signalOUT(rewsawtoothwave);
    } //end switch
    DDRD = 0; PORTD = 0;

  } //end if (regim<5)

}


void monitor_out() {
  String dutystr, stepstr;
  dutystr = String(String(duty) + "%");
  stepstr = String("Step= " + String(shag));

  lcd.clear();
  lcd.setCursor(0, 0);

  if (freq < 10000) {
    lcd.print(freq);
    lcd.print(" Hz");
  } else {
    lcd.print( ((float)freq / 1000), 3);
    lcd.print(" kHz");
  }

  lcd.setCursor(0, 1);
  switch (regim) {
    case 0: lcd.print("SINE"); break;
    case 1: lcd.print("TRI"); break;
    case 2: lcd.print("SQUARE"); break;
    case 3: lcd.print("SAW R"); break;
    case 4: lcd.print("SAW L"); break;
    case 5: lcd.print("PRECISE"); break;
    case 6: lcd.print("DUTY "); break;
  }

  if (regim == 6) {
    lcd.setCursor(12, 1);
    lcd.print(duty);
    lcd.setCursor(15, 1);
    lcd.print("%");
  }
  else {
    lcd.setCursor(10, 1);
    lcd.print("<");
    lcd.print(shag);    
    lcd.print(">");
  }


  /*
    lcd.clrScr();
    //Вывод первой строчки
    lcd.setFont(SmallFont);
    if (freq < 10000) {
    lcd.print("Frequency, Hz", LEFT, 0 );
    }
    if (freq >= 10000) {
    lcd.print("Frequency, kHz", LEFT, 0 );
    }
    //Вывод второй строчки
    lcd.setFont(MediumNumbers);
    if (freq < 10000) {
    lcd.printNumI(freq, CENTER, 8);
    }
    if (freq >= 10000u && freq < 1000000ul ) {
    lcd.printNumF( ((float)freq / 1000), 3 , CENTER, 8);
    }
    if (freq >= 1000000ul ) {
    lcd.printNumF( ((float)freq / 1000), 2 , CENTER, 8);
    }
    //Вывод третьей строчки
    lcd.setFont(SmallFont);
    switch (regim) {
    case 0: lcd.print("Sinus DDS", CENTER, 32); break;
    case 1: lcd.print("Triangle DDS", CENTER, 32); break;
    case 2: lcd.print("Meandr DDS", CENTER, 32); break;
    case 3: lcd.print("Pila1 DDS", CENTER, 32); break;
    case 4: lcd.print("Pila2 DDS", CENTER, 32); break;
    case 5: lcd.print("PWM Mode", CENTER, 32); break;
    case 6: lcd.print("Duty Mode", CENTER, 32);
    }
    //Вывод четвёртой строчки
    if (regim == 6) lcd.print(dutystr, CENTER, 40);
    else lcd.print(stepstr, CENTER, 40);
  */
}//end monitor out


void set_duty() {
  //float ocr,delta_ocr;
  if (regim == 6 && ICR1 < 100) return;
  if (regim == 5 && ICR1 < 100) {
    OCR1A = ICR1 / 2; duty = 50;
    return;
  }
  static uint16_t ocr;
  ocr = (uint32_t)ICR1 * duty / 100;
  OCR1A = ocr;
}

void check_regim() { // проверка и установка режимов генератора
  if (regim < 5) {
    if (freq > 100000) freq = 100000;
    TCCR1B = 0;
    TCCR1A = 0;  DDRB &= ~(1 << DDB1); // 9 pin arduino set Z-mode
  }// end if regim <5

  if (regim > 4) {
    TCCR1A = 1 << COM1A1; DDRB |= 1 << DDB1; // 9 pin set output (pwm out)
    if (TCCR1B == 17 && ICR1 < 2800) {
      ICR1 = icr; freq = (float) 8000000UL / ICR1;
      set_duty();
    }
    else {
      pwm_gen();
    }
  }
  PORTB |= 1 << 7;
  monitor_flag = 1;
}
